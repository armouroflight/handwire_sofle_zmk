## boards/shields/handwire_armour/Kconfig.defconfig
```kconfig
if SHIELD_HANDWIRE_ARMOUR_RIGHT

# Name less than 16 char
config ZMK_KEYBOARD_NAME
    default "Handwire Armour"

config ZMK_SPLIT_ROLE_CENTRAL
    default y

endif

if SHIELD_HANDWIRE_ARMOUR_RIGHT || SHIELD_HANDWIRE_ARMOUR_LEFT

config ZMK_SPLIT
    default y

endif
```

## boards/shields/handwire_armour/Kconfig.shield
```kconfig
config SHIELD_HANDWIRE_ARMOUR_LEFT
    def_bool $(shields_list_contains, handwire_armour_left)


config SHIELD_HANDWIRE_ARMOUR_RIGHT
    def_bool $(shields_list_contains, handwire_armour_right)
```
